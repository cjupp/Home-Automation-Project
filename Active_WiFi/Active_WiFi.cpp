/*--------------------------------------------------------------------------------------------------------------------
| active_wifi.c: 
|
| Created by:     Cameron Jupp
| Date Started:   December 3, 2022
--------------------------------------------------------------------------------------------------------------------*/
#include "WiFi.h"
#include "Active_WiFi.h"
#include <Arduino.h>
#include <WiFi.h>
#include <stdio.h>
#include <EEPROM.h>
#include "Serial_Tools.h"



// -------------------------------------------------------------------------------------------------------------------- //
// -------------------------- / ___/  / /     / __  /  / _ /    / _\      / /     / ____/ ----------------------------- //
// ------------------------- / /_//  / /__   / /_/ /  / _  \   / /_\\    / /__    \__ \  ------------------------------ //
// ------------------------ /____/  /____/  /_____/  /_____/  /_/   \\  /____/  /_____/ ------------------------------- //
// -------------------------------------------------------------------------------------------------------------------- //

//Create array of WAP objects
WAP network_list[NETLIST_SZ];

// -------------------------------------------------------------------------------------------------------------------- //
// --------------------------- / ___/  / /     /  \      / ____/  / ____/  / ___/  / ____/ ---------------------------- //
// -------------------------- / /__   / /__   / /_\\     \__ \    \__ \   / __/    \__ \  ----------------------------- //
// ------------------------- /____/  /____/  /_/   \\  /_____/  /_____/  /____/  /_____/ ------------------------------ //
// -------------------------------------------------------------------------------------------------------------------- //

// -------------------------------------------------------------------------------------------------------------------- //
// --------------------------------------------------- WAP CLASS ------------------------------------------------------ //
// -------------------------------------------------------------------------------------------------------------------- //

/*---------------------------------------------------------------------------------------------------------------------
| {FUNCTION NAME}: 
|        -------------------------------------------------------------------------------------------------------
| Arguments:
| - 
|        -------------------------------------------------------------------------------------------------------
| Returns: nothing
|
|        -------------------------------------------------------------------------------------------------------
| Notes/Future Changes:
| - 
|        -------------------------------------------------------------------------------------------------------
| Created by: Cameron Jupp
| Date:       {Date}
| Edited:     {Date}  
----------------------------------------------------------------------------------------------------------------------*/
  void WAP::copy_str(char * in_str, char * out_str)
  {
    int i = 0;

    do
    {
      out_str[i] = in_str[i];
    }while(in_str[i++] != '\0' && i < CHAR_LIM);
  }

  
/*---------------------------------------------------------------------------------------------------------------------
| {FUNCTION NAME}: 
|        -------------------------------------------------------------------------------------------------------
| Arguments:
| - 
|        -------------------------------------------------------------------------------------------------------
| Returns: nothing
|
|        -------------------------------------------------------------------------------------------------------
| Notes/Future Changes:
| - 
|        -------------------------------------------------------------------------------------------------------
| Created by: Cameron Jupp
| Date:       {Date}
| Edited:     {Date}  
----------------------------------------------------------------------------------------------------------------------*/
  void WAP::save(char * addr_ptr, int data_sz)
  { 
    for(int i = 0; i < data_sz; i++)
    {
      EEPROM.write(i, addr_ptr[i]);
      EEPROM.commit(); 
    }
  }
  
  
/*---------------------------------------------------------------------------------------------------------------------
| {FUNCTION NAME}: 
|        -------------------------------------------------------------------------------------------------------
| Arguments:
| - 
|        -------------------------------------------------------------------------------------------------------
| Returns: nothing
|
|        -------------------------------------------------------------------------------------------------------
| Notes/Future Changes:
| - 
|        -------------------------------------------------------------------------------------------------------
| Created by: Cameron Jupp
| Date:       {Date}
| Edited:     {Date}  
----------------------------------------------------------------------------------------------------------------------*/
  void WAP::load(char * addr_ptr, int data_sz)
  {
    for(int i = 0; i < data_sz; i++)
    {
      addr_ptr[i] = EEPROM.read(i);
    }
  }


/*---------------------------------------------------------------------------------------------------------------------
| {FUNCTION NAME}: 
|        -------------------------------------------------------------------------------------------------------
| Arguments:
| - 
|        -------------------------------------------------------------------------------------------------------
| Returns: nothing
|
|        -------------------------------------------------------------------------------------------------------
| Notes/Future Changes:
| - 
|        -------------------------------------------------------------------------------------------------------
| Created by: Cameron Jupp
| Date:       {Date}
| Edited:     {Date}  
----------------------------------------------------------------------------------------------------------------------*/
  int WAP::config()
  {
      //Select the element of the array you want to overwrite
  //Serial.print("Please enter the ");
  
  //Request the access point information
  Serial.println("Enter the SSID: ");
  this->set_ssid(serial_gets());

  Serial.println("Enter the password: ");
  this->set_password(serial_gets());

  //Check to see if the network connects
  return this->connect();

  }
  
  
/*---------------------------------------------------------------------------------------------------------------------
| {FUNCTION NAME}: 
|        -------------------------------------------------------------------------------------------------------
| Arguments:
| - 
|        -------------------------------------------------------------------------------------------------------
| Returns: nothing
|
|        -------------------------------------------------------------------------------------------------------
| Notes/Future Changes:
| - 
|        -------------------------------------------------------------------------------------------------------
| Created by: Cameron Jupp
| Date:       {Date}
| Edited:     {Date}  
----------------------------------------------------------------------------------------------------------------------*/
  void WAP::set_ssid(char * new_ssid)
  {
    copy_str(new_ssid, this->ssid);
  }


/*---------------------------------------------------------------------------------------------------------------------
| {FUNCTION NAME}: 
|        -------------------------------------------------------------------------------------------------------
| Arguments:
| - 
|        -------------------------------------------------------------------------------------------------------
| Returns: nothing
|
|        -------------------------------------------------------------------------------------------------------
| Notes/Future Changes:
| - 
|        -------------------------------------------------------------------------------------------------------
| Created by: Cameron Jupp
| Date:       {Date}
| Edited:     {Date}  
----------------------------------------------------------------------------------------------------------------------*/
  void WAP::set_password(char * new_password)
  {
    copy_str(new_password, this->password);
  }


/*---------------------------------------------------------------------------------------------------------------------
| {FUNCTION NAME}: 
|        -------------------------------------------------------------------------------------------------------
| Arguments:
| - 
|        -------------------------------------------------------------------------------------------------------
| Returns: nothing
|
|        -------------------------------------------------------------------------------------------------------
| Notes/Future Changes:
| - 
|        -------------------------------------------------------------------------------------------------------
| Created by: Cameron Jupp
| Date:       {Date}
| Edited:     {Date}  
----------------------------------------------------------------------------------------------------------------------*/
  int WAP::connect()
  {
    //Disconnect before attempting to connect
    WiFi.disconnect();

    //Display information to console
    Serial.print("Connecting to network:");

    //Switch to station mode and connect to the 
    WiFi.mode(WIFI_STA);
    WiFi.begin(this->ssid, this->password);

    unsigned long startAttemptTime = millis();

    while(WiFi.status() != WL_CONNECTED && millis() - startAttemptTime < WIFI_TIMEOUT_MS)
    {
      Serial.print(".");
      delay(100);
    }

    Serial.println();
    char * wap_ptr = (char*)this;
    
    if (WiFi.status() == WL_CONNECTED)
    {
      //Display message and save configuration as configured
      Serial.println("Wifi connected!");
      this->status = CONFIGURED;
      this->save(wap_ptr, sizeof(*this));

      //Print out the IP address
      //Serial.println("IP Address: ");
      //Serial.println(Wifi.localIP());
      return 0;
    }
    else
    {
      //Display message and save configuration as unconfigured
      Serial.println("Could not connect to WiFi network");
      this->status = UNCONFIGURED;
      this->save(wap_ptr, sizeof(*this));
      return -1;
    }
  }



// -------------------------------------------------------------------------------------------------------------------- //
// -------------------  / ___/  / / //  / \  / /  / ___/ /__  __/  /_  _/  / __  /  / \  / /  / ____/ ----------------- //
// ------------------  / __/   / /_//  / /\\/ /  / /__     / /      / /   / /_/ /  / /\\/ /   \__ \ ------------------- //
// -----------------  /_/     /____/  /_/  \_/  /____/    /_/     /___/  /_____/  /_/  \_/  /_____/ ------------------- //
// -------------------------------------------------------------------------------------------------------------------- //

void init_wifi_system()
{
    //Initialize the EEPROM memory
    EEPROM.begin(512);

    start_check();
}


/*---------------------------------------------------------------------------------------------------------------------
| {FUNCTION NAME}: 
|        --------------------------------------------------------------------------------------------------------------
| Arguments:
| - 
|        -------------------------------------------------------------------------------------------------------
| Returns: nothing
|
|        -------------------------------------------------------------------------------------------------------
| Notes/Future Changes:
| - 
|        -------------------------------------------------------------------------------------------------------
| Created by: Cameron Jupp
| Date:       {Date}
| Edited:     {Date}  
----------------------------------------------------------------------------------------------------------------------*/
int start_check()
{ 
  //Display message to serial terminal
  Serial.println("Checking for previous wifi configuration...");
  
  //Create a pointer for the first access point and treat it as an array of bytes 
  char* wap_ptr = (char*)&network_list[0];
  network_list[0].load(wap_ptr, sizeof(network_list[0]));

  Serial.println(network_list[0].status);

  if(network_list[0].status == CONFIGURED)
  {
    Serial.println("Network found!");
    network_list[0].connect();
    return 0;
  }
  else
  {
    Serial.println("No configuration found. Starting setup...");
    init_wifi(&network_list[0]);
    return -1;
  }
}


/*---------------------------------------------------------------------------------------------------------------------
| {FUNCTION NAME}: 
|        --------------------------------------------------------------------------------------------------------------
| Arguments:
| - 
|        -------------------------------------------------------------------------------------------------------
| Returns: nothing
|
|        -------------------------------------------------------------------------------------------------------
| Notes/Future Changes:
| - 
|        -------------------------------------------------------------------------------------------------------
| Created by: Cameron Jupp
| Date:       {Date}
| Edited:     {Date}  
----------------------------------------------------------------------------------------------------------------------*/
void scan_waps()
{
 //Scan wifi access points

 //Write them to a variable/array

 //display them to the serial monitor

 //return array of names
 
}


/*---------------------------------------------------------------------------------------------------------------------
| {FUNCTION NAME}: 
|        -------------------------------------------------------------------------------------------------------
| Arguments:
| - 
|        -------------------------------------------------------------------------------------------------------
| Returns: nothing
|
|        -------------------------------------------------------------------------------------------------------
| Notes/Future Changes:
| - 
|        -------------------------------------------------------------------------------------------------------
| Created by: Cameron Jupp
| Date:       {Date}
| Edited:     {Date}  
----------------------------------------------------------------------------------------------------------------------*/
void init_wifi(WAP * init_wap)
{
  //Continuously ask for credentials until wifi successfully connects
  //If the network connects successfully, exit the function
  //If the wifi does not connect, ask for user input again
  while(init_wap->config());
}
